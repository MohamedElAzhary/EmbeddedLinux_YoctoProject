## meta-audio-distro/conf/distro/audio.conf
```bitbake
# Distribution Information.
DISTRO = "audio"
DISTRO_NAME = "audio_distro"
DISTRO_VERSION = "1.0"

# SDK Information.
SDK_VENDOR = "-AzharySDK"
SDK_VERSION = "${@d.getVar('DISTRO_VERSION').replace('snapshot-${METADATA_REVISION}', 'snapshot')}"
SDK_VERSION[vardepvalue] = "${SDK_VERSION}"
SDK_NAME = "${DISTRO}-${TCLIBC}-${SDKMACHINE}-${IMAGE_BASENAME}-${TUNE_PKGARCH}-${MACHINE}"

# Installation path
SDKPATHINSTALL = "/opt/${DISTRO}/${SDK_VERSION}"

# Distribution Features --> used to add customized packages conditionally.
AUDIO_DEFAULT_DISTRO_FEATURES = "largefile ptest multiarch bluez5 bluetooth wifi audio_only"
AUDIO_DEFAULT_EXTRA_RDEPENDS = "packagegroup-core-boot"
AUDIO_DEFAULT_EXTRA_RRECOMMENDS = "kernel-module-af-packet"

DISTRO_FEATURES ?= "${DISTRO_FEATURES_DEFAULT} ${AUDIO_DEFAULT_DISTRO_FEATURES} userland"

# sysvinit as init manager
require conf/distro/include/sysvinit.inc

# Preferred version for packages
PREFERRED_VERSION_linux-yocto ?= "5.15%"
PREFERRED_VERSION_linux-yocto-rt ?= "5.15%"

# Build System configuration.
LOCALCONF_VERSION = "2"

# Poky sanity checks
INHERIT += "poky-sanity"
```

## meta-infotainment-distro/conf/distro/infotainment.conf
```bitbake
# Distribution Information.
DISTRO = "infotainment"
DISTRO_NAME = "infotainment_distro"
DISTRO_VERSION = "1.0"

# SDK Information.
SDK_VENDOR = "-AzharySDK"
SDK_VERSION = "${@d.getVar('DISTRO_VERSION').replace('snapshot-${METADATA_REVISION}', 'snapshot')}"
SDK_VERSION[vardepvalue] = "${SDK_VERSION}"
SDK_NAME = "${DISTRO}-${TCLIBC}-${SDKMACHINE}-${IMAGE_BASENAME}-${TUNE_PKGARCH}-${MACHINE}"

# Installation path
SDKPATHINSTALL = "/opt/${DISTRO}/${SDK_VERSION}"

# Distro Features
INFOTAINMENT_DEFAULT_DISTRO_FEATURES = "largefile opengl multiarch vulkan x11 bluez5 bluetooth wifi qt5"
INFOTAINMENT_DEFAULT_EXTRA_RDEPENDS = "packagegroup-core-boot"
INFOTAINMENT_DEFAULT_EXTRA_RRECOMMENDS = "kernel-module-af-packet"

DISTRO_FEATURES ?= "${DISTRO_FEATURES_DEFAULT} ${INFOTAINMENT_DEFAULT_DISTRO_FEATURES} userland"

# systemd as init manager
require conf/distro/include/systemd.inc


# Packages Version
PREFERRED_VERSION_linux-yocto ?= "5.15%"
PREFERRED_VERSION_linux-yocto-rt ?= "5.15%"


# Build System configuration.
LOCALCONF_VERSION = "2"

# Poky sanity checks
INHERIT += "poky-sanity"
```
